## Kconfig.projbuild
```kconfig
menu "Data Format"

    config DATAFORMAT_BUFFERS_INPSRAM
        depends on SPIRAM
        bool "Set buffers in SPIRAM."
        default n
        help
            Set buffers in SPIRAM, if low DRAM. 

    config DATAFORMAT_DEFAULT_DATA_SIZE
        int "Set default data size for SPIFFS."
        default 256
        help
            Default data size for field "text" (for "data" divided 2). 

    config CRC_IN_RAM
        bool "Place CRC code and data in IRAM"
        default y
        help
            Speed up.

    config CBOR_BINARY_FIELD
        bool "CBOR binary"
        default y
        help
            CBOR binary for reducing data.

    config CBOR_BINARY_FIELD_NAME
        depends on CBOR_BINARY_FIELD
        string "CBOR binary field"
        default "data"
        help
            This option defines the name of the json field for binary cbor field.
endmenu
```
